## components/esp_wifi_qemu/Kconfig.projbuild
```kconfig
menu "Virtual Wi-Fi (QEMU)"

    config ESP_WIFI_QEMU
        bool "Enable virtual Wi-Fi driver for QEMU"
        default y
        help
            Replaces the real Wi-Fi blob driver with a lightweight MMIO shim
            that bridges to the host wpa_supplicant daemon via Unix ctrl socket.
            Enable this option only when targeting the Espressif QEMU fork.
            Must NOT be enabled for real hardware builds.
            Default is y: this component is ONLY added to EXTRA_COMPONENT_DIRS
            when building for QEMU, so defaulting to y means no sdkconfig
            change is needed in stock samples.

    config ESP_WIFI_QEMU_AP_FAKE_CLIENTS
        int "Fake AP clients to inject on softAP start"
        depends on ESP_WIFI_QEMU
        range 0 4
        default 2
        help
            When the firmware starts in AP or APSTA mode, the QEMU shim
            posts this many synthetic WIFI_EVENT_AP_STACONNECTED events
            with deterministic MACs (02:QE:00:00:00:NN) and AID = NN+1.
            Stock softAP samples then log the join messages and
            esp_wifi_ap_get_sta_list returns these entries.  Set to 0 to
            keep the AP empty (legacy behaviour).

endmenu
```

## main/Kconfig.projbuild
```kconfig
menu "Demo Wi-Fi Configuration"

    config DEMO_WIFI_SSID
        string "Wi-Fi SSID"
        default "QEMU_TEST"
        help
            Wi-Fi SSID used by the QEMU integration demo.
            Must match the mock_wpa_supplicant SSID (default: QEMU_TEST).

    config DEMO_WIFI_PASSWORD
        string "Wi-Fi Password"
        default "qemu1234"
        help
            Wi-Fi password for the QEMU integration demo.

endmenu

menu "lwIP Probe Configuration"

    config DEMO_LWIP_PROBE_ENABLE
        bool "Enable lwIP probe task (NEXT-004)"
        default y
        help
            Spawn a background TCP probe task after Wi-Fi connects.
            Used by QEMU integration tests to validate the full data-plane.

    config DEMO_LWIP_PROBE_HOST
        string "Probe target host (IP address)"
        default "10.0.2.100"
        depends on DEMO_LWIP_PROBE_ENABLE
        help
            IPv4 address of the TCP echo server launched by the test harness.

    config DEMO_LWIP_PROBE_PORT
        int "Probe target port"
        default 9988
        depends on DEMO_LWIP_PROBE_ENABLE
        help
            TCP port of the echo server (tools/echo_server.py).

endmenu
```
